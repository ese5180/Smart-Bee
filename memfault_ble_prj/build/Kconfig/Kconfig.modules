## memfault_ble_prj/build/hci_ipc/Kconfig/soc/Kconfig
```kconfig
# Load Zephyr SoC Kconfig descriptions.
osource "/home/adi262/fp-f24-iot-venture-pitch-smartbeehive/memfault_ble_prj/zephyr/soc/xlnx/zynqmp/Kconfig"
osource "/home/adi262/fp-f24-iot-venture-pitch-smartbeehive/memfault_ble_prj/zephyr/soc/xlnx/zynq7000/Kconfig"
osource "/home/adi262/fp-f24-iot-venture-pitch-smartbeehive/memfault_ble_prj/zephyr/soc/xen/Kconfig"
osource "/home/adi262/fp-f24-iot-venture-pitch-smartbeehive/memfault_ble_prj/zephyr/soc/ti/simplelink/Kconfig"
osource "/home/adi262/fp-f24-iot-venture-pitch-smartbeehive/memfault_ble_prj/zephyr/soc/ti/lm3s6965/Kconfig"
osource "/home/adi262/fp-f24-iot-venture-pitch-smartbeehive/memfault_ble_prj/zephyr/soc/ti/k3/Kconfig"
osource "/home/adi262/fp-f24-iot-venture-pitch-smartbeehive/memfault_ble_prj/zephyr/soc/telink/tlsr/Kconfig"
osource "/home/adi262/fp-f24-iot-venture-pitch-smartbeehive/memfault_ble_prj/zephyr/soc/starfive/jh71xx/Kconfig"
osource "/home/adi262/fp-f24-iot-venture-pitch-smartbeehive/memfault_ble_prj/zephyr/soc/st/stm32/Kconfig"
osource "/home/adi262/fp-f24-iot-venture-pitch-smartbeehive/memfault_ble_prj/zephyr/soc/snps/qemu_arc/Kconfig"
osource "/home/adi262/fp-f24-iot-venture-pitch-smartbeehive/memfault_ble_prj/zephyr/soc/snps/nsim/Kconfig"
osource "/home/adi262/fp-f24-iot-venture-pitch-smartbeehive/memfault_ble_prj/zephyr/soc/snps/hsdk4xd/Kconfig"
osource "/home/adi262/fp-f24-iot-venture-pitch-smartbeehive/memfault_ble_prj/zephyr/soc/snps/hsdk/Kconfig"
osource "/home/adi262/fp-f24-iot-venture-pitch-smartbeehive/memfault_ble_prj/zephyr/soc/snps/emsk/Kconfig"
osource "/home/adi262/fp-f24-iot-venture-pitch-smartbeehive/memfault_ble_prj/zephyr/soc/snps/emsdp/Kconfig"
osource "/home/adi262/fp-f24-iot-venture-pitch-smartbeehive/memfault_ble_prj/zephyr/soc/snps/arc_iot/Kconfig"
osource "/home/adi262/fp-f24-iot-venture-pitch-smartbeehive/memfault_ble_prj/zephyr/soc/silabs/Kconfig"
osource "/home/adi262/fp-f24-iot-venture-pitch-smartbeehive/memfault_ble_prj/zephyr/soc/sifive/sifive_freedom/Kconfig"
osource "/home/adi262/fp-f24-iot-venture-pitch-smartbeehive/memfault_ble_prj/zephyr/soc/rockchip/Kconfig"
osource "/home/adi262/fp-f24-iot-venture-pitch-smartbeehive/memfault_ble_prj/zephyr/soc/renode/riscv_virtual/Kconfig"
osource "/home/adi262/fp-f24-iot-venture-pitch-smartbeehive/memfault_ble_prj/zephyr/soc/renesas/smartbond/Kconfig"
osource "/home/adi262/fp-f24-iot-venture-pitch-smartbeehive/memfault_ble_prj/zephyr/soc/renesas/rzt2m/Kconfig"
osource "/home/adi262/fp-f24-iot-venture-pitch-smartbeehive/memfault_ble_prj/zephyr/soc/renesas/rcar/Kconfig"
osource "/home/adi262/fp-f24-iot-venture-pitch-smartbeehive/memfault_ble_prj/zephyr/soc/renesas/ra/Kconfig"
osource "/home/adi262/fp-f24-iot-venture-pitch-smartbeehive/memfault_ble_prj/zephyr/soc/raspberrypi/Kconfig"
osource "/home/adi262/fp-f24-iot-venture-pitch-smartbeehive/memfault_ble_prj/zephyr/soc/quicklogic/eos_s3/Kconfig"
osource "/home/adi262/fp-f24-iot-venture-pitch-smartbeehive/memfault_ble_prj/zephyr/soc/qemu/virt_riscv/Kconfig"
osource "/home/adi262/fp-f24-iot-venture-pitch-smartbeehive/memfault_ble_prj/zephyr/soc/qemu/malta/Kconfig"
osource "/home/adi262/fp-f24-iot-venture-pitch-smartbeehive/memfault_ble_prj/zephyr/soc/openisa/rv32m1/Kconfig"
osource "/home/adi262/fp-f24-iot-venture-pitch-smartbeehive/memfault_ble_prj/zephyr/soc/nxp/s32/Kconfig"
osource "/home/adi262/fp-f24-iot-venture-pitch-smartbeehive/memfault_ble_prj/zephyr/soc/nxp/rw/Kconfig"
osource "/home/adi262/fp-f24-iot-venture-pitch-smartbeehive/memfault_ble_prj/zephyr/soc/nxp/mcx/Kconfig"
osource "/home/adi262/fp-f24-iot-venture-pitch-smartbeehive/memfault_ble_prj/zephyr/soc/nxp/lpc/Kconfig"
osource "/home/adi262/fp-f24-iot-venture-pitch-smartbeehive/memfault_ble_prj/zephyr/soc/nxp/layerscape/Kconfig"
osource "/home/adi262/fp-f24-iot-venture-pitch-smartbeehive/memfault_ble_prj/zephyr/soc/nxp/kinetis/Kconfig"
osource "/home/adi262/fp-f24-iot-venture-pitch-smartbeehive/memfault_ble_prj/zephyr/soc/nxp/imxrt/Kconfig"
osource "/home/adi262/fp-f24-iot-venture-pitch-smartbeehive/memfault_ble_prj/zephyr/soc/nxp/imx/Kconfig"
osource "/home/adi262/fp-f24-iot-venture-pitch-smartbeehive/memfault_ble_prj/zephyr/soc/nuvoton/numicro/Kconfig"
osource "/home/adi262/fp-f24-iot-venture-pitch-smartbeehive/memfault_ble_prj/zephyr/soc/nuvoton/numaker/Kconfig"
osource "/home/adi262/fp-f24-iot-venture-pitch-smartbeehive/memfault_ble_prj/zephyr/soc/nuvoton/npcx/Kconfig"
osource "/home/adi262/fp-f24-iot-venture-pitch-smartbeehive/memfault_ble_prj/zephyr/soc/nordic/Kconfig"
osource "/home/adi262/fp-f24-iot-venture-pitch-smartbeehive/memfault_ble_prj/zephyr/soc/neorv32/Kconfig"
osource "/home/adi262/fp-f24-iot-venture-pitch-smartbeehive/memfault_ble_prj/zephyr/soc/native/inf_clock/Kconfig"
osource "/home/adi262/fp-f24-iot-venture-pitch-smartbeehive/memfault_ble_prj/zephyr/soc/microchip/miv/Kconfig"
osource "/home/adi262/fp-f24-iot-venture-pitch-smartbeehive/memfault_ble_prj/zephyr/soc/microchip/mec/Kconfig"
osource "/home/adi262/fp-f24-iot-venture-pitch-smartbeehive/memfault_ble_prj/zephyr/soc/lowrisc/opentitan/Kconfig"
osource "/home/adi262/fp-f24-iot-venture-pitch-smartbeehive/memfault_ble_prj/zephyr/soc/litex/litex_vexriscv/Kconfig"
osource "/home/adi262/fp-f24-iot-venture-pitch-smartbeehive/memfault_ble_prj/zephyr/soc/ite/ec/Kconfig"
osource "/home/adi262/fp-f24-iot-venture-pitch-smartbeehive/memfault_ble_prj/zephyr/soc/intel/raptor_lake/Kconfig"
osource "/home/adi262/fp-f24-iot-venture-pitch-smartbeehive/memfault_ble_prj/zephyr/soc/intel/lakemont/Kconfig"
osource "/home/adi262/fp-f24-iot-venture-pitch-smartbeehive/memfault_ble_prj/zephyr/soc/intel/intel_socfpga_std/Kconfig"
osource "/home/adi262/fp-f24-iot-venture-pitch-smartbeehive/memfault_ble_prj/zephyr/soc/intel/intel_socfpga/Kconfig"
osource "/home/adi262/fp-f24-iot-venture-pitch-smartbeehive/memfault_ble_prj/zephyr/soc/intel/intel_niosv/Kconfig"
osource "/home/adi262/fp-f24-iot-venture-pitch-smartbeehive/memfault_ble_prj/zephyr/soc/intel/intel_ish/Kconfig"
osource "/home/adi262/fp-f24-iot-venture-pitch-smartbeehive/memfault_ble_prj/zephyr/soc/intel/intel_adsp/Kconfig"
osource "/home/adi262/fp-f24-iot-venture-pitch-smartbeehive/memfault_ble_prj/zephyr/soc/intel/elkhart_lake/Kconfig"
osource "/home/adi262/fp-f24-iot-venture-pitch-smartbeehive/memfault_ble_prj/zephyr/soc/intel/atom/Kconfig"
osource "/home/adi262/fp-f24-iot-venture-pitch-smartbeehive/memfault_ble_prj/zephyr/soc/intel/apollo_lake/Kconfig"
osource "/home/adi262/fp-f24-iot-venture-pitch-smartbeehive/memfault_ble_prj/zephyr/soc/intel/alder_lake/Kconfig"
osource "/home/adi262/fp-f24-iot-venture-pitch-smartbeehive/memfault_ble_prj/zephyr/soc/infineon/cat3/Kconfig"
osource "/home/adi262/fp-f24-iot-venture-pitch-smartbeehive/memfault_ble_prj/zephyr/soc/infineon/cat1a/Kconfig"
osource "/home/adi262/fp-f24-iot-venture-pitch-smartbeehive/memfault_ble_prj/zephyr/soc/gd/gd32/Kconfig"
osource "/home/adi262/fp-f24-iot-venture-pitch-smartbeehive/memfault_ble_prj/zephyr/soc/gaisler/leon3/Kconfig"
osource "/home/adi262/fp-f24-iot-venture-pitch-smartbeehive/memfault_ble_prj/zephyr/soc/gaisler/gr716a/Kconfig"
osource "/home/adi262/fp-f24-iot-venture-pitch-smartbeehive/memfault_ble_prj/zephyr/soc/espressif/Kconfig"
osource "/home/adi262/fp-f24-iot-venture-pitch-smartbeehive/memfault_ble_prj/zephyr/soc/ene/kb1200/Kconfig"
osource "/home/adi262/fp-f24-iot-venture-pitch-smartbeehive/memfault_ble_prj/zephyr/soc/efinix/sapphire/Kconfig"
osource "/home/adi262/fp-f24-iot-venture-pitch-smartbeehive/memfault_ble_prj/zephyr/soc/cdns/xtensa_sample_controller/Kconfig"
osource "/home/adi262/fp-f24-iot-venture-pitch-smartbeehive/memfault_ble_prj/zephyr/soc/cdns/dc233c/Kconfig"
osource "/home/adi262/fp-f24-iot-venture-pitch-smartbeehive/memfault_ble_prj/zephyr/soc/brcm/bcmvk/Kconfig"
osource "/home/adi262/fp-f24-iot-venture-pitch-smartbeehive/memfault_ble_prj/zephyr/soc/brcm/bcm2712/Kconfig"
osource "/home/adi262/fp-f24-iot-venture-pitch-smartbeehive/memfault_ble_prj/zephyr/soc/brcm/bcm2711/Kconfig"
osource "/home/adi262/fp-f24-iot-venture-pitch-smartbeehive/memfault_ble_prj/zephyr/soc/atmel/sam0/Kconfig"
osource "/home/adi262/fp-f24-iot-venture-pitch-smartbeehive/memfault_ble_prj/zephyr/soc/atmel/sam/Kconfig"
osource "/home/adi262/fp-f24-iot-venture-pitch-smartbeehive/memfault_ble_prj/zephyr/soc/aspeed/Kconfig"
osource "/home/adi262/fp-f24-iot-venture-pitch-smartbeehive/memfault_ble_prj/zephyr/soc/arm/Kconfig"
osource "/home/adi262/fp-f24-iot-venture-pitch-smartbeehive/memfault_ble_prj/zephyr/soc/arm/beetle/Kconfig"
osource "/home/adi262/fp-f24-iot-venture-pitch-smartbeehive/memfault_ble_prj/zephyr/soc/andestech/Kconfig"
osource "/home/adi262/fp-f24-iot-venture-pitch-smartbeehive/memfault_ble_prj/zephyr/soc/ambiq/Kconfig"
osource "/home/adi262/fp-f24-iot-venture-pitch-smartbeehive/memfault_ble_prj/zephyr/soc/altr/zephyr_nios2f/Kconfig"
osource "/home/adi262/fp-f24-iot-venture-pitch-smartbeehive/memfault_ble_prj/zephyr/soc/altr/qemu_nios2/Kconfig"
```
