## memfault_ble_prj/build/Kconfig/Kconfig.modules
```kconfig
menu "nrf (/home/adi262/fp-f24-iot-venture-pitch-smartbeehive/memfault_ble_prj/nrf)"
osource "/home/adi262/fp-f24-iot-venture-pitch-smartbeehive/memfault_ble_prj/nrf/Kconfig.nrf"
config ZEPHYR_NRF_MODULE
	bool
	default y
endmenu
menu "mcuboot (/home/adi262/fp-f24-iot-venture-pitch-smartbeehive/memfault_ble_prj/bootloader/mcuboot)"
osource "$(ZEPHYR_MCUBOOT_KCONFIG)"
config ZEPHYR_MCUBOOT_MODULE
	bool
	default y
endmenu
menu "mbedtls (/home/adi262/fp-f24-iot-venture-pitch-smartbeehive/memfault_ble_prj/modules/crypto/mbedtls)"
osource "$(ZEPHYR_MBEDTLS_KCONFIG)"
config ZEPHYR_MBEDTLS_MODULE
	bool
	default y
endmenu
menu "oberon-psa-crypto (/home/adi262/fp-f24-iot-venture-pitch-smartbeehive/memfault_ble_prj/modules/crypto/oberon-psa-crypto)"
osource "/home/adi262/fp-f24-iot-venture-pitch-smartbeehive/memfault_ble_prj/modules/crypto/oberon-psa-crypto/Kconfig.oberon_psa_crypto"
config ZEPHYR_OBERON_PSA_CRYPTO_MODULE
	bool
	default y
endmenu
menu "trusted-firmware-m (/home/adi262/fp-f24-iot-venture-pitch-smartbeehive/memfault_ble_prj/modules/tee/tf-m/trusted-firmware-m)"
osource "$(ZEPHYR_TRUSTED_FIRMWARE_M_KCONFIG)"
config ZEPHYR_TRUSTED_FIRMWARE_M_MODULE
	bool
	default y
endmenu
config ZEPHYR_PSA_ARCH_TESTS_MODULE
   bool
   default y
config ZEPHYR_SOC_HWMV1_MODULE
   bool
   default y
menu "cjson (/home/adi262/fp-f24-iot-venture-pitch-smartbeehive/memfault_ble_prj/modules/lib/cjson)"
osource "$(ZEPHYR_CJSON_KCONFIG)"
config ZEPHYR_CJSON_MODULE
	bool
	default y
endmenu
menu "azure-sdk-for-c (/home/adi262/fp-f24-iot-venture-pitch-smartbeehive/memfault_ble_prj/modules/lib/azure-sdk-for-c)"
osource "$(ZEPHYR_AZURE_SDK_FOR_C_KCONFIG)"
config ZEPHYR_AZURE_SDK_FOR_C_MODULE
	bool
	default y
endmenu
menu "cirrus-logic (/home/adi262/fp-f24-iot-venture-pitch-smartbeehive/memfault_ble_prj/modules/hal/cirrus-logic)"
osource "/home/adi262/fp-f24-iot-venture-pitch-smartbeehive/memfault_ble_prj/modules/hal/cirrus-logic/Kconfig"
config ZEPHYR_CIRRUS_LOGIC_MODULE
	bool
	default y
endmenu
menu "openthread (/home/adi262/fp-f24-iot-venture-pitch-smartbeehive/memfault_ble_prj/modules/lib/openthread)"
osource "$(ZEPHYR_OPENTHREAD_KCONFIG)"
config ZEPHYR_OPENTHREAD_MODULE
	bool
	default y
endmenu
menu "suit-generator (/home/adi262/fp-f24-iot-venture-pitch-smartbeehive/memfault_ble_prj/modules/lib/suit-generator)"
osource "/home/adi262/fp-f24-iot-venture-pitch-smartbeehive/memfault_ble_prj/modules/lib/suit-generator/ncs/Kconfig"
config ZEPHYR_SUIT_GENERATOR_MODULE
	bool
	default y
endmenu
menu "suit-processor (/home/adi262/fp-f24-iot-venture-pitch-smartbeehive/memfault_ble_prj/modules/lib/suit-processor)"
osource "/home/adi262/fp-f24-iot-venture-pitch-smartbeehive/memfault_ble_prj/modules/lib/suit-processor/Kconfig"
config ZEPHYR_SUIT_PROCESSOR_MODULE
	bool
	default y
endmenu
menu "memfault-firmware-sdk (/home/adi262/fp-f24-iot-venture-pitch-smartbeehive/memfault_ble_prj/modules/lib/memfault-firmware-sdk)"
osource "/home/adi262/fp-f24-iot-venture-pitch-smartbeehive/memfault_ble_prj/modules/lib/memfault-firmware-sdk/ports/zephyr/Kconfig"
config ZEPHYR_MEMFAULT_FIRMWARE_SDK_MODULE
	bool
	default y
endmenu
menu "coremark (/home/adi262/fp-f24-iot-venture-pitch-smartbeehive/memfault_ble_prj/modules/benchmark/coremark)"
osource "$(ZEPHYR_COREMARK_KCONFIG)"
config ZEPHYR_COREMARK_MODULE
	bool
	default y
endmenu
menu "canopennode (/home/adi262/fp-f24-iot-venture-pitch-smartbeehive/memfault_ble_prj/modules/lib/canopennode)"
osource "$(ZEPHYR_CANOPENNODE_KCONFIG)"
config ZEPHYR_CANOPENNODE_MODULE
	bool
	default y
endmenu
menu "chre (/home/adi262/fp-f24-iot-venture-pitch-smartbeehive/memfault_ble_prj/modules/lib/chre)"
osource "/home/adi262/fp-f24-iot-venture-pitch-smartbeehive/memfault_ble_prj/modules/lib/chre/platform/zephyr/Kconfig"
config ZEPHYR_CHRE_MODULE
	bool
	default y
endmenu
menu "lz4 (/home/adi262/fp-f24-iot-venture-pitch-smartbeehive/memfault_ble_prj/modules/lib/lz4)"
osource "$(ZEPHYR_LZ4_KCONFIG)"
config ZEPHYR_LZ4_MODULE
	bool
	default y
endmenu
menu "nanopb (/home/adi262/fp-f24-iot-venture-pitch-smartbeehive/memfault_ble_prj/modules/lib/nanopb)"
osource "$(ZEPHYR_NANOPB_KCONFIG)"
config ZEPHYR_NANOPB_MODULE
	bool
	default y
endmenu
config ZEPHYR_TF_M_TESTS_MODULE
   bool
   default y
menu "zscilib (/home/adi262/fp-f24-iot-venture-pitch-smartbeehive/memfault_ble_prj/modules/lib/zscilib)"
osource "/home/adi262/fp-f24-iot-venture-pitch-smartbeehive/memfault_ble_prj/modules/lib/zscilib/Kconfig.zscilib"
config ZEPHYR_ZSCILIB_MODULE
	bool
	default y
endmenu
menu "cmsis (/home/adi262/fp-f24-iot-venture-pitch-smartbeehive/memfault_ble_prj/modules/hal/cmsis)"
osource "$(ZEPHYR_CMSIS_KCONFIG)"
config ZEPHYR_CMSIS_MODULE
	bool
	default y
endmenu
menu "cmsis-dsp (/home/adi262/fp-f24-iot-venture-pitch-smartbeehive/memfault_ble_prj/modules/lib/cmsis-dsp)"
osource "$(ZEPHYR_CMSIS_DSP_KCONFIG)"
config ZEPHYR_CMSIS_DSP_MODULE
	bool
	default y
endmenu
menu "cmsis-nn (/home/adi262/fp-f24-iot-venture-pitch-smartbeehive/memfault_ble_prj/modules/lib/cmsis-nn)"
osource "$(ZEPHYR_CMSIS_NN_KCONFIG)"
config ZEPHYR_CMSIS_NN_MODULE
	bool
	default y
endmenu
menu "fatfs (/home/adi262/fp-f24-iot-venture-pitch-smartbeehive/memfault_ble_prj/modules/fs/fatfs)"
osource "$(ZEPHYR_FATFS_KCONFIG)"
config ZEPHYR_FATFS_MODULE
	bool
	default y
endmenu
menu "hal_nordic (/home/adi262/fp-f24-iot-venture-pitch-smartbeehive/memfault_ble_prj/modules/hal/nordic)"
osource "$(ZEPHYR_HAL_NORDIC_KCONFIG)"
config ZEPHYR_HAL_NORDIC_MODULE
	bool
	default y
endmenu
menu "hal_st (/home/adi262/fp-f24-iot-venture-pitch-smartbeehive/memfault_ble_prj/modules/hal/st)"
osource "$(ZEPHYR_HAL_ST_KCONFIG)"
config ZEPHYR_HAL_ST_MODULE
	bool
	default y
endmenu
config ZEPHYR_HAL_WURTHELEKTRONIK_MODULE
   bool
   default y
config ZEPHYR_LIBMETAL_MODULE
   bool
   default y
menu "liblc3 (/home/adi262/fp-f24-iot-venture-pitch-smartbeehive/memfault_ble_prj/modules/lib/liblc3)"
osource "$(ZEPHYR_LIBLC3_KCONFIG)"
config ZEPHYR_LIBLC3_MODULE
	bool
	default y
endmenu
menu "littlefs (/home/adi262/fp-f24-iot-venture-pitch-smartbeehive/memfault_ble_prj/modules/fs/littlefs)"
osource "$(ZEPHYR_LITTLEFS_KCONFIG)"
config ZEPHYR_LITTLEFS_MODULE
	bool
	default y
endmenu
menu "loramac-node (/home/adi262/fp-f24-iot-venture-pitch-smartbeehive/memfault_ble_prj/modules/lib/loramac-node)"
osource "$(ZEPHYR_LORAMAC_NODE_KCONFIG)"
config ZEPHYR_LORAMAC_NODE_MODULE
	bool
	default y
endmenu
menu "lvgl (/home/adi262/fp-f24-iot-venture-pitch-smartbeehive/memfault_ble_prj/modules/lib/gui/lvgl)"
osource "/home/adi262/fp-f24-iot-venture-pitch-smartbeehive/memfault_ble_prj/modules/lib/gui/lvgl/Kconfig"
config ZEPHYR_LVGL_MODULE
	bool
	default y
endmenu
config ZEPHYR_MIPI_SYS_T_MODULE
   bool
   default y
config ZEPHYR_NRF_HW_MODELS_MODULE
   bool
   default y
config ZEPHYR_OPEN_AMP_MODULE
   bool
   default y
menu "picolibc (/home/adi262/fp-f24-iot-venture-pitch-smartbeehive/memfault_ble_prj/modules/lib/picolibc)"
osource "/home/adi262/fp-f24-iot-venture-pitch-smartbeehive/memfault_ble_prj/modules/lib/picolibc/zephyr/Kconfig"
config ZEPHYR_PICOLIBC_MODULE
	bool
	default y
endmenu
menu "segger (/home/adi262/fp-f24-iot-venture-pitch-smartbeehive/memfault_ble_prj/modules/debug/segger)"
osource "$(ZEPHYR_SEGGER_KCONFIG)"
config ZEPHYR_SEGGER_MODULE
	bool
	default y
endmenu
config ZEPHYR_TINYCRYPT_MODULE
   bool
   default y
menu "uoscore-uedhoc (/home/adi262/fp-f24-iot-venture-pitch-smartbeehive/memfault_ble_prj/modules/lib/uoscore-uedhoc)"
osource "$(ZEPHYR_UOSCORE_UEDHOC_KCONFIG)"
config ZEPHYR_UOSCORE_UEDHOC_MODULE
	bool
	default y
endmenu
menu "zcbor (/home/adi262/fp-f24-iot-venture-pitch-smartbeehive/memfault_ble_prj/modules/lib/zcbor)"
osource "$(ZEPHYR_ZCBOR_KCONFIG)"
config ZEPHYR_ZCBOR_MODULE
	bool
	default y
endmenu
menu "nrfxlib (/home/adi262/fp-f24-iot-venture-pitch-smartbeehive/memfault_ble_prj/nrfxlib)"
osource "/home/adi262/fp-f24-iot-venture-pitch-smartbeehive/memfault_ble_prj/nrfxlib/Kconfig.nrfxlib"
config ZEPHYR_NRFXLIB_MODULE
	bool
	default y
endmenu
menu "connectedhomeip (/home/adi262/fp-f24-iot-venture-pitch-smartbeehive/memfault_ble_prj/modules/lib/matter)"
osource "/home/adi262/fp-f24-iot-venture-pitch-smartbeehive/memfault_ble_prj/modules/lib/matter/config/nrfconnect/chip-module/Kconfig"
config ZEPHYR_CONNECTEDHOMEIP_MODULE
	bool
	default y
endmenu
```

## memfault_ble_prj/build/Kconfig/Kconfig.shield.defconfig
```kconfig
osource "/home/adi262/fp-f24-iot-venture-pitch-smartbeehive/memfault_ble_prj/boards/shields/*/Kconfig.defconfig"
osource "/home/adi262/fp-f24-iot-venture-pitch-smartbeehive/memfault_ble_prj/nrf/boards/shields/*/Kconfig.defconfig"
```

## memfault_ble_prj/build/Kconfig/arch/Kconfig
```kconfig
# Load arch Kconfig descriptions.
osource "/home/adi262/fp-f24-iot-venture-pitch-smartbeehive/memfault_ble_prj/zephyr/arch/x86/Kconfig"
osource "/home/adi262/fp-f24-iot-venture-pitch-smartbeehive/memfault_ble_prj/zephyr/arch/xtensa/Kconfig"
osource "/home/adi262/fp-f24-iot-venture-pitch-smartbeehive/memfault_ble_prj/zephyr/arch/sparc/Kconfig"
osource "/home/adi262/fp-f24-iot-venture-pitch-smartbeehive/memfault_ble_prj/zephyr/arch/riscv/Kconfig"
osource "/home/adi262/fp-f24-iot-venture-pitch-smartbeehive/memfault_ble_prj/zephyr/arch/posix/Kconfig"
osource "/home/adi262/fp-f24-iot-venture-pitch-smartbeehive/memfault_ble_prj/zephyr/arch/nios2/Kconfig"
osource "/home/adi262/fp-f24-iot-venture-pitch-smartbeehive/memfault_ble_prj/zephyr/arch/mips/Kconfig"
osource "/home/adi262/fp-f24-iot-venture-pitch-smartbeehive/memfault_ble_prj/zephyr/arch/arm64/Kconfig"
osource "/home/adi262/fp-f24-iot-venture-pitch-smartbeehive/memfault_ble_prj/zephyr/arch/arm/Kconfig"
osource "/home/adi262/fp-f24-iot-venture-pitch-smartbeehive/memfault_ble_prj/zephyr/arch/arc/Kconfig"
```

## memfault_ble_prj/build/hci_ipc/Kconfig/Kconfig.shield
```kconfig
osource "/home/adi262/fp-f24-iot-venture-pitch-smartbeehive/memfault_ble_prj/boards/shields/*/Kconfig.shield"
osource "/home/adi262/fp-f24-iot-venture-pitch-smartbeehive/memfault_ble_prj/nrf/boards/shields/*/Kconfig.shield"
```
